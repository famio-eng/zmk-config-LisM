#include <input/processors/runtime-input-processor.dtsi>

/ {
    mouse_runtime_input_processor_central: mouse_runtime_input_processor_central {
        compatible = "zmk,input-processor-runtime";
        processor-label = "central";
        type = <INPUT_EV_REL>;
        x-codes = <INPUT_REL_X>;
        y-codes = <INPUT_REL_Y>;
        scale-multiplier = <1>;
        scale-divisor = <1>;
        rotation-degrees = <0>;
        track-remainders;

        temp-layer-transparent-behavior = <&trans>;
        temp-layer-kp-behavior = <&kp>;
        temp-layer-keep-keycodes = <LEFT_CONTROL LEFT_SHIFT LEFT_ALT LEFT_GUI RIGHT_CONTROL RIGHT_SHIFT RIGHT_ALT RIGHT_GUI>;

        // 2026-11-19: 実機でDYA Studioのライブ設定として入れていた「ボールを動かすと
        // Mouse Layer(1)に自動遷移するtemp-layer」を既定値として焼き込み(NVS破損で消失)。
        // activation/deactivation delayの実際の変更履歴は見つからず、
        // zmk-module-runtime-input-processorのyaml既定値(activation 100ms / deactivation 500ms)
        // をそのまま採用(Logs/2026-08-21.mdに「一定時間(deactivation delay、デフォルト500ms)」の記述あり、
        // 変更した形跡なし)。クリック等保護キーでの延長はfamio-engフォーク(fix/click-extends-temp-layer)で対応済み。
        temp-layer-enabled;
        temp-layer = <1>;
        temp-layer-activation-delay-ms = <100>;
        temp-layer-deactivation-delay-ms = <500>;

        #input-processor-cells = <0>;
    };

    mouse_runtime_input_processor_peripheral: mouse_runtime_input_processor_peripheral {
        compatible = "zmk,input-processor-runtime";
        processor-label = "periph";
        type = <INPUT_EV_REL>;
        x-codes = <INPUT_REL_X>;
        y-codes = <INPUT_REL_Y>;
        scale-multiplier = <1>;
        scale-divisor = <1>;
        rotation-degrees = <0>;
        track-remainders;

        temp-layer-transparent-behavior = <&trans>;
        temp-layer-kp-behavior = <&kp>;
        temp-layer-keep-keycodes = <LEFT_CONTROL LEFT_SHIFT LEFT_ALT LEFT_GUI RIGHT_CONTROL RIGHT_SHIFT RIGHT_ALT RIGHT_GUI>;

        #input-processor-cells = <0>;
    };
};